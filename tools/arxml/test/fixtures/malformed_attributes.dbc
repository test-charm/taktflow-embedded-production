VERSION ""

NS_ :

BS_:

BU_: ECU_A ECU_B

BO_ 257 MalformedAttributes: 8 ECU_A
 SG_ MalformedValue : 0|8@1+ (1,0) [0|255] "" ECU_B

BA_DEF_ BO_ "GenMsgCycleTime" STRING;
BA_ "GenMsgCycleTime" BO_ 257 "fast";
