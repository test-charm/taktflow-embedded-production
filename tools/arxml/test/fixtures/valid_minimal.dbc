VERSION ""

NS_ :

BS_:

BU_: ECU_A ECU_B

BO_ 256 ValidMessage: 8 ECU_A
 SG_ ValidSignal : 0|8@1+ (1,0) [0|255] "" ECU_B

BA_DEF_ BO_ "GenMsgCycleTime" INT 0 65535;
BA_DEF_ BO_ "GenMsgSendType" STRING;
BA_ "GenMsgCycleTime" BO_ 256 10;
BA_ "GenMsgSendType" BO_ 256 "Cyclic";
